#include <Flash.h>
#include <nRF24L01.h>
#include <RF24.h>
#include <RF24_config.h>
#include <SPI.h>
#include <Timer.h>


#include "pitches.h"

//LED RGB PINS
#define   RED 3
#define GREEN 6
#define  BLUE 5

// FRAME'S STEPS ARRAY
FLASH_TABLE(byte, color_table, 4, 
                  {255, 111, 0,3},  
                  {255,  0,123,0}, 
                  {  0,  0,  0,0},
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                  {  0,  0,  0,0},
                  );

//BIP DE RESET
const int resetSOUND[] = {NOTE_B5,10,NOTE_B5,1,NOTE_D3,8,NOTE_B0,8,NOTE_GS1,8,NOTE_DS8,6};

Timer t;

//CMD CODES 
const String STARTC = "_START";
const String RESETC = "_RESET";
const String WAIT   = "|WAIT|";

int messageLength = 6;
int msg[1];
int thePass = 0;

RF24 radio(9,10);

const uint64_t pipe = 0xE8E8F0F0E1LL;

int lastmsg = 1;
String theMessage = "";

//FLAGS, ALWAYS YOU NEED A LOT 
boolean playRoutine = false;
boolean reseted =false;
boolean syncDev = false;

//HACE FALTA Q COMENTE ALGO O.o
void setup(){
  Serial.begin(57600);
  rgb_setup();
  initDev();
  radio.begin();
  radio.openReadingPipe(1,pipe);
  radio.startListening();
  int tickEvent = t.every(250,doYourRoutine);
  
}

void loop(){
   t.update();
  if (radio.available()){
    bool done = false;  
      done = radio.read(msg, 1); 
      char theChar = msg[0];
      if (msg[0] != 2){
        theMessage.concat(theChar);
        }
      else {
       if (theMessage.length() == messageLength) { 
         char codeS=convertCode(theMessage);
         switch(codeS){
          case 'r' :{ initDev(); reseted = true; break;}
          case 'w' :{ /*Serial.println("PREPARE 4 ROUTINE..."); */syncDev = true; _playMusic(2);  break;}
          case 's' : {playRoutine = true;/* Serial.print(thePass); Serial.print(".");*/ break;}
        }  
       }
       theMessage= ""; 
      }
   }
   
}


//Prepare arrived code (OH YEAH!)
char convertCode(String Message){
  char rCode = 'c';
  if(Message == RESETC){
      rCode = 'r';
  }else if(Message == STARTC){
      rCode = 's';
  }else if(Message == WAIT){
       rCode = 'w';
  }
  return rCode;
  
}

//CUMBIAS TILINGAS FOR THE ROLLINGAS BITCH
void _playMusic(int toneCode)
{

   int noteDuration = 1000/resetSOUND[toneCode+1];
   tone(8,resetSOUND[toneCode],noteDuration);
   int pauseBetweenNotes = noteDuration * 1.30;
   delay(pauseBetweenNotes);
   noTone(8);
 }
 
//MOVE YOUR ASS BABY 
 void doYourRoutine(){
   if(playRoutine && syncDev && reseted){
     thePass++;
     if(color_table.rows() > thePass){
       rgb_set_values(color_table[thePass][0],color_table[thePass][1],color_table[thePass][2]);
        _playMusic(color_table[thePass][3]+3);
     }
     
   }
 }
 
 //THE LIGTHS, I CAN SEE THE LIGHT, AND IS SO BEAUTIFUL
 void rgb_setup()
  {
      pinMode(GREEN, OUTPUT);
      pinMode(BLUE, OUTPUT);
      pinMode(RED, OUTPUT);
      digitalWrite(GREEN, HIGH);
      digitalWrite(BLUE, HIGH);
      digitalWrite(RED, HIGH);
  }

//SETTING... OH SI
void rgb_set_values(byte r,byte g,byte b)
  {

      analogWrite(GREEN,255- r);
      analogWrite(BLUE, 255-g);
      analogWrite(RED,255- b);
  }
  
//I'M DON'T KNOW WHT WRITE HERE...SORRY
void initDev(){
  thePass=0; 
  playRoutine = false;  
  reseted =false;
  syncDev = false;
  rgb_set_values(0,0,0);
 /* Serial.println();
  Serial.println("SERVER RESTARTED..."); */
  _playMusic(0); 
}
